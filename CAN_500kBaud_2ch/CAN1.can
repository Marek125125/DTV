/*@!Encoding:65001*/
includes
{
  
}

variables
{
  
}

on message CAN1.*
{
  message CAN2.* m;
  if(this.DIR==RX)
  {
    if(this.CAN==1)
    {
      m=this;
      output(m);
    }
  } 
}

on message CAN2.*
{
  message CAN1.* m;
  if(this.DIR==RX)
  {
    if(this.CAN==2)
    {
      m=this;
      output(m);
    }
  } 
}